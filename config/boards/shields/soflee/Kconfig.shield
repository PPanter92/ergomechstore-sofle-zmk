## config/boards/shields/soflee/Kconfig.shield
```kconfig
# Copyright (c) 2020 Ryan Cross
# SPDX-License-Identifier: MIT

config SHIELD_SOFLEE_LEFT
    def_bool $(shields_list_contains,soflee_left)

config SHIELD_SOFLEE_RIGHT
    def_bool $(shields_list_contains,soflee_right)
```

## config/west.yml
```yaml
manifest:
  remotes:
    - name: zmkfirmware
      url-base: https://github.com/zmkfirmware
    - name: urob
      url-base: https://github.com/urob
  projects:
    - name: zmk
      remote: zmkfirmware
      revision: main
      revision: v0.2 # set to desired version 
      import: app/west.yml
    - name: zmk-auto-layer
      remote: urob
      revision: v0.2 # set to same version
  self:
    path: config
```
