/*
 * Copyright (c) 2020 Ryan Cross
 *
 * SPDX-License-Identifier: MIT
 */

#include "boards/shields/sofle/sofle.dtsi"

&kscan0 {
    col-gpios
        = <&pro_micro 19 GPIO_ACTIVE_HIGH>
        , <&pro_micro 18 GPIO_ACTIVE_HIGH>
        , <&pro_micro 15 GPIO_ACTIVE_HIGH>
        , <&pro_micro 14 GPIO_ACTIVE_HIGH>
        , <&pro_micro 16 GPIO_ACTIVE_HIGH>
        ;
};

&left_encoder {
    status = "okay";
};

 key_switch_0: key_switch_0 {
        gpios = <&gpio0 3 GPIO_ACTIVE_HIGH>;
        label = "EXTRA_0";
    };

    key_switch_1: key_switch_1 {
        gpios = <&gpio0 4 GPIO_ACTIVE_HIGH>;
        label = "EXTRA_1";
    };
